//
// frИquence = pas / s
// 1 tour = 200 pas
// 1 tour = ratio * Pi * diametre_roue
// vitesse = cm/s = 1 tour / 1600 pas * frИquence

//
// diametre_roue = 10 cm
// ratio = 3
// 1 tour = 94,25 cm
// si on veut 50 cm/s, il faut 1/2 tour par seconde = 200 impulsions par seconde


//----- Include Files ---------------------------------------------------------
#include <avr/io.h>		// include I/O definitions (port names, pin names, etc)
#include <avr/interrupt.h>	// include interrupt support
#include <math.h>

#include "global.h"		// include our global settings
#include "timer.h"		// include timer function library (timing, PWM, etc)
#include "pulse.h"		// include pulse function library



u16 freq[255] = {41.79,66.83,85.81,101.54,115.16,127.30,138.31,148.45,157.87,166.69,175.00,182.88,190.38,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671.31,672.16};

//----- Begin Code ------------------------------------------------------------
int main(void)
{
	u08 j;
	u16 i;
	
	// initialize the timer system
	timerInit();
	
	// set pulse pins as output
	// ** these are the correct pins for most processors, but not all **
	sbi(DDRB, 1);
	sbi(DDRB, 2); // OAC1A
	
	
	pulseInit();
	pulseT1Init();
		
	// sortie
	DDRB = 0xFF;
	cbi(PORTB,0);	// DIR G
	cbi(PORTB,4);	// ENA G
	cbi(PORTB,3);	// DIR D
	cbi(PORTB,5);	// ENA D
		
	// pulse
	
	sbi(PORTB,4);
	sbi(PORTB,5);
		
	for (j=0; j<5; j++) {
	
	for (i=0; i< 255; i++) {	
		pulseT1ASetFreq(freq[i]);
		pulseT1ARun(1);
		while (pulseT1ARemaining());
		
	}
	
	pulseT1ASetFreq(freq[254]);
	pulseT1ARun(300);
	while (pulseT1ARemaining());
	
	for (i=0; i< 255; i++) {	
		pulseT1ASetFreq(freq[254-i]);
		pulseT1ARun(1);
		while (pulseT1ARemaining());
		
	}
	
	}

	cbi(PORTB,4);
	cbi(PORTB,5);
	
	pulseT1AStop();
	pulseT1BStop();
	pulseT1Off();
	return 0;
}

